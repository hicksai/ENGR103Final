#include <Adafruit_CircuitPlayground.h>
#include <AsyncDelay.h>
#include <Wire.h>
#include <SPI.h>

//Instances of AsyncDelay

AsyncDelay delayTime;

// Words taken from Adafruit Circuit Playground Express "Speech Demos"
const uint8_t spBUTTON[] PROGMEM = {0xA9,0x69,0xCE,0xC2,0x45,0x14,0x9F,0x28,0xFB,0xB5,0x14,0xDD,0x78,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0xFF,0x61};
const uint8_t spSWITCH[] PROGMEM = {0x08,0xB8,0x84,0x95,0x01,0x5F,0x73,0x30,0xE0,0x73,0x0B,0x01,0x7C,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0xFF,0x15};
const uint8_t spRIGHT[] PROGMEM = {0xAA,0x90,0xD5,0xAD,0x55,0x9D,0xA9,0x56,0x94,0xD4,0x0A,0x97,0xAB,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0xFF,0x01};
const uint8_t spLEFT[] PROGMEM = {0x6E,0x4C,0xB8,0x8B,0xB5,0xDA,0xA6,0x75,0x23,0xEA,0x24,0x4B,0x1B,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0xF1,0xFF};
const uint8_t spPASS[] PROGMEM = {0x0A,0xC8,0x33,0x83,0x03,0xA3,0xEC,0x55,0x2D,0xD4,0x12,0xAF,0xAA,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0xFF,0x03};
const uint8_t spZERO[] PROGMEM = {0x69,0xFB,0x59,0xDD,0x51,0xD5,0xD7,0xB5,0x6F,0x0A,0x78,0xC0,0x52,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0xFF,0x1F};
const uint8_t spONE[] PROGMEM = {0x66,0x4E,0xA8,0x7A,0x8D,0xED,0xC4,0xB5,0xCD,0x89,0xD4,0xBC,0xA2,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0xFE,0x1F};
const uint8_t spTWO[] PROGMEM = {0x06,0xB8,0x59,0x34,0x00,0x27,0xD6,0x38,0x60,0x58,0xD3,0x91,0x55,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0xFF,0x1F};
const uint8_t spTHREE[] PROGMEM = {0x0C,0xE8,0x2E,0x94,0x01,0x4D,0xBA,0x4A,0x40,0x03,0x16,0x68,0x69,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0xFF,0x03};
const uint8_t spFOUR[] PROGMEM = {0x08,0x68,0x21,0x0D,0x03,0x1C,0x90,0xC0,0x88,0x92,0xB2,0x29,0x87,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0xFC,0x3F};
const uint8_t spFIVE[] PROGMEM = {0x08,0x68,0x4E,0x9D,0x02,0x1C,0x60,0xC0,0x8C,0x69,0x12,0xB0,0xC0,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0xFF,0x01};
const uint8_t spSIX[] PROGMEM = {0x04,0xF8,0xB9,0x55,0x01,0xBF,0xA5,0x1B,0xE0,0x37,0x0F,0x03,0xFC,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0xFC,0x3F};
const uint8_t spSEVEN[] PROGMEM = {0x0C,0x78,0xC6,0x95,0x01,0x3F,0xA5,0x28,0xE0,0xB7,0x52,0x0B,0x04,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0xFF,0x07};
const uint8_t spEIGHT[] PROGMEM = {0xAD,0x1B,0xDE,0x58,0x23,0x17,0xAF,0x6E,0xE8,0x20,0xEB,0x5C,0xBC,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0xFF,0x0F};
const uint8_t spNINE[] PROGMEM = {0x62,0x75,0xDC,0x33,0xB5,0x62,0xB9,0x25,0x0B,0x8E,0x34,0x8F,0xD3,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0xFF,0x03};
const uint8_t spTEN[] PROGMEM = {0x0A,0xD8,0x5C,0x4D,0x03,0x2B,0xAB,0x5E,0xC4,0x33,0x2B,0xAF,0x62,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0xFD,0x7F};
const uint8_t spELEVEN[] PROGMEM = {0x29,0x6F,0x52,0xA8,0xBB,0x6A,0x8F,0xBA,0x2B,0xC5,0xE8,0x9C,0xBD,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0xF4,0xFF};
const uint8_t spTWELVE[] PROGMEM = {0x09,0x98,0xDA,0x22,0x01,0x37,0x78,0x1A,0x20,0x85,0xD1,0x50,0x3A,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0xFE,0x1F};
const uint8_t spTHIRTEEN[] PROGMEM = {0x08,0x18,0xA2,0x12,0x03,0x18,0x40,0xC0,0x50,0x13,0x25,0x1D,0x3A,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0xFC,0x7F};
const uint8_t spFOURTEEN[] PROGMEM = {0x08,0xE8,0x2A,0x94,0x00,0xC3,0x56,0x10,0x60,0xFA,0x0A,0x01,0x4C,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0xFF,0x0F};
const uint8_t spFIFTEEN[] PROGMEM = {0x02,0x68,0xD6,0xCC,0x00,0x43,0x9A,0x39,0x60,0x3A,0xF7,0x51,0x34,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0xFF,0x0F};
const uint8_t spSIXTEEN[] PROGMEM = {0x0C,0x78,0xC6,0x95,0x01,0x3F,0xA5,0x28,0xE0,0xB7,0x52,0x0B,0x04,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0xFF,0x1F};
const uint8_t spSEVENTEEN[] PROGMEM = {0x0C,0xF8,0x29,0x45,0x01,0xBF,0x95,0x5A,0x20,0x00,0xBF,0xA5,0x3A,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0xFE,0x1F};
const uint8_t spEIGHTEEN[] PROGMEM = {0x6B,0x18,0x36,0x88,0x3B,0x1B,0xEF,0x61,0x0D,0xD3,0x27,0x52,0xE5,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0xFF,0x01};
const uint8_t spNINETEEN[] PROGMEM = {0x6E,0x2F,0x44,0xB4,0x5B,0x93,0xA6,0xAD,0x32,0x96,0x2E,0x69,0xBA,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0xFF,0x0F};
const uint8_t spTWENTY[] PROGMEM = {0x0A,0xE8,0x4A,0xCD,0x01,0xDB,0xB9,0x33,0xC0,0xA6,0x54,0x0C,0xA4,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0xFF,0x1F};
const uint8_t spTHIRTY[] PROGMEM = {0x02,0x18,0xA2,0x52,0x02,0x16,0x60,0xC0,0x50,0x13,0x25,0x6B,0x2C,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0xFF,0x0F};
const uint8_t spPUSH[] PROGMEM = {0x06,0x28,0x22,0x5D,0x03,0xCB,0x4B,0x2A,0x23,0x03,0xDB,0x9E,0xB8,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0xFF,0x0F};
const uint8_t spSQUALK[] PROGMEM = {0x0C,0x78,0xC6,0x95,0x01,0x3F,0xA5,0x28,0xE0,0xB7,0x52,0x0B,0x04,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0xFC,0x3F};
const uint8_t spMOVE[] PROGMEM = {0x6A,0xD7,0xC2,0xF2,0xD2,0xEC,0xB8,0x39,0x08,0xF6,0x4D,0x4D,0x1A,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0xFF,0x07};
const uint8_t spREPEAT[] PROGMEM = {0x6E,0xF1,0x49,0x42,0x33,0xD8,0xC5,0xB9,0x8C,0xB9,0x62,0x8A,0x87,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0xFF,0x0F};

//Pins
const byte switchPin = 7;
const byte rightButton = 5;
const byte leftButton = 4;

//Booleans
bool gameRunning = 1;
bool userWins = 0;

bool RButtonFlag = 0;
bool LButtonFlag = 0;
bool switchFlag = 0;

//floats for sensors
float X, Y, Z, totalAccel;

//integers
int score = 0;
int roundNumber = 0;
int actionType = 0;


void setup() {

  Serial.begin(9600);
  CircuitPlayground.begin();
  CircuitPlayground.setAccelRange(LIS3DH_RANGE_4_G);
  randomSeed(analogRead(1));

  pinMode(switchPin, INPUT_PULLUP);
  pinMode(rightButton, INPUT_PULLDOWN);
  pinMode(leftButton, INPUT_PULLDOWN);

  //ISRs
  attachInterrupt(digitalPinToInterrupt(switchPin), switchISR, CHANGE);
  attachInterrupt(digitalPinToInterrupt(rightButton), RButtonISR, FALLING);
  attachInterrupt(digitalPinToInterrupt(leftButton), LButtonISR, FALLING);

  actionType = random(0,4);
  assignAction();
  delayTime.start(1000, AsyncDelay::MILLIS);
}

void loop() {
  while(gameRunning) {
    if (roundNumber<10) {
      for (int i = 0; i<=roundNumber; i++) {
        CircuitPlayground.setPixelColor(i,0,0,255);
      }
      for (int i = roundNumber; i>=0; i--) {
        CircuitPlayground.setPixelColor(i,0,0,0);
      }
    } else if (roundNumber<20) {
      for (int i = 0; i<=roundNumber-10; i++) {
        CircuitPlayground.setPixelColor(i,0,255,0);
      }
      for (int i = roundNumber; i>=0; i--) {
        CircuitPlayground.setPixelColor(i,0,0,0);
      }
    }
    if (delayTime.isExpired()) {
      
      switch (actionType) {
        case 0:
          if (!RButtonFlag) {
            //User Loses
            for (int i = 0; i<10; i++) {
              CircuitPlayground.setPixelColor(i,255,0,0);
            }
            score = roundNumber;
            returnScore();
            gameRunning = 0;
          } else {
            roundNumber++;
            RButtonFlag = 0;
          }
          break;
        case 1:
          if (!LButtonFlag) {
            //User Loses
            for (int i = 0; i<10; i++) {
              CircuitPlayground.setPixelColor(i,255,0,0);
            }
            score = roundNumber;
            returnScore();
            gameRunning = 0;
          } else {
            roundNumber++;
            LButtonFlag = 0;
          }
          break;
        case 2:
          if (!switchFlag) {
            //User Loses
            for (int i = 0; i<10; i++) {
              CircuitPlayground.setPixelColor(i,255,0,0);
            }
            score = roundNumber;
            returnScore();
            gameRunning = 0;
          } else {
            roundNumber++;
            switchFlag = 0;
          }
          break;
        case 3:
          getAccel();
          if (totalAccel < 10) {
            //User Loses
            for (int i = 0; i<10; i++) {
              CircuitPlayground.setPixelColor(i,255,0,0);
            }
            score = roundNumber;
            returnScore();
            gameRunning = 0;
          } else {
            roundNumber++;
          }
          break;
      }
      if (roundNumber>=20) {
      // User Wins!
      userWins = 1;
      returnScore();
      gameRunning = 0;
      } else if (gameRunning) {
        actionType = random(0,4);
        assignAction();
        delayTime.restart();
      }
    }
  }
  if (userWins) {
    confetti(40);
  }
}

void returnScore() {
  switch (score) {
    case 0:
      CircuitPlayground.speaker.say(spZERO);
      break;
    case 1:
      CircuitPlayground.speaker.say(spONE);
      break;
    case 2:
      CircuitPlayground.speaker.say(spTWO);
      break;
    case 3:
      CircuitPlayground.speaker.say(spTHREE);
      break;
    case 4:
      CircuitPlayground.speaker.say(spFOUR);
      break;
    case 5:
      CircuitPlayground.speaker.say(spFIVE);
      break;
    case 6:
      CircuitPlayground.speaker.say(spSIX);
      break;
    case 7:
      CircuitPlayground.speaker.say(spSEVEN);
      break;
    case 8:
      CircuitPlayground.speaker.say(spEIGHT);
      break;
    case 9:
      CircuitPlayground.speaker.say(spNINE);
      break;
    case 10:
      CircuitPlayground.speaker.say(spTEN);
      break;
    case 11:
      CircuitPlayground.speaker.say(spELEVEN);
      break;
    case 12:
      CircuitPlayground.speaker.say(spTWELVE);
      break;
    case 13:
      CircuitPlayground.speaker.say(spTHIRTEEN);
      break;
    case 14:
      CircuitPlayground.speaker.say(spFOURTEEN);
      break;
    case 15:
      CircuitPlayground.speaker.say(spFIFTEEN);
      break;
    case 16:
      CircuitPlayground.speaker.say(spSIXTEEN);
      break;
    case 17:
      CircuitPlayground.speaker.say(spSEVENTEEN);
      break;
    case 18:
      CircuitPlayground.speaker.say(spEIGHTEEN);
      break;
    case 19:
      CircuitPlayground.speaker.say(spNINETEEN);
      break;
    case 20:
      CircuitPlayground.speaker.say(spTWENTY);
      break;
  }
}

//Function to get average of 10 acceleration data points
void getAccel() {
  X = 0;
  Y = 0;
  Z = 0;
  for (int i=0; i<10; i++) {
    X += CircuitPlayground.motionX();
    Y += CircuitPlayground.motionY();
    Z += CircuitPlayground.motionZ();
    delay(5);
  }
  X /= 10;
  Y /= 10;
  Z /= 10;

  totalAccel = sqrt(X*X + Y*Y + Z*Z);
}


/*Tell the user which action to do
0: right button
1: left button
2: slide switch
3: shake (move)
*/
void assignAction() {
  switch (actionType) {
    case 0:
      Serial.println("Right Button");
      CircuitPlayground.speaker.say(spRIGHT);
      CircuitPlayground.speaker.say(spBUTTON);
      
      break;
    case 1:
      Serial.println("Left Button");
      CircuitPlayground.speaker.say(spLEFT);
      CircuitPlayground.speaker.say(spBUTTON);
      
      break;
    case 2:
      Serial.println("Switch");
      CircuitPlayground.speaker.say(spSWITCH);
      
      break;
    case 3:
      Serial.println("Shake");
      CircuitPlayground.speaker.say(spMOVE);
      
      break;
  }
}

//Celebration funciton if the user wins
//Credit: 
void confetti(int speed) {
  for (int i = 0; i<(100); i++) {
   CircuitPlayground.setPixelColor(i, random(0,225), random(0,225), random(0,225));
  }
  delay(speed);
}

//ISR functions
void switchISR() {
  switchFlag = 1;
}

void RButtonISR() {
  RButtonFlag = 1;
}

void LButtonISR() {
  LButtonFlag = 1;
}